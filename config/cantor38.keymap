/* source key position labels */
#include "cantor_keylabels.h"

/* map Cantor-38's extra keys */
#define X_MB &trans &trans // thumb row, upper
#define X_LH TOG_NUM  // thumb row, left
#define X_RH TOG_NUM  // thumb row, right


#define X_LH_GAME &kp LSHIFT  // thumb row, left
#define X_RH_GAME TOG_NUM  // thumb row, right


/* activate bluetooth */
#define CONFIG_WIRELESS 1

/* source the main keymap */
#include "base.keymap"

/* use 5-column layout for Zen */
ZMK_APPLY_MATRIX_TRANSFORM(default_transform)
