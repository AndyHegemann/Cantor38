## boards/shields/Cantor38/Kconfig.defconfig
```kconfig
config ZMK_BLE
    default y

config ZMK_USB
    default y



if CANTOR38_LEFT

config ZMK_KEYBOARD_NAME
    default "Cantor-38"

config ZMK_SPLIT_ROLE_CENTRAL
    default y

endif



if CANTOR38_LEFT || CANTOR38_RIGHT

config ZMK_SPLIT
    default y

endif
```

## boards/shields/Cantor38/Kconfig.shield
```kconfig
config CANTOR38_LEFT
    def_bool $(shields_list_contains,cantor38_left)

config CANTOR38_RIGHT
    def_bool $(shields_list_contains,cantor38_right)

CONFIG_ZMK_KSCAN_DIRECT_POLLING=y
```

## config/west.yml
```yaml
manifest:
  remotes:
    - name: zmkfirmware
      url-base: https://github.com/urob
    - name: urob
      url-base: https://github.com/urob
  projects:
    - name: zmk
      remote: zmkfirmware
      revision: main
      import: app/west.yml
    - name: zmk-helpers
      remote: urob
      revision: v2 # this will eventually become main

   # ZMK modules
    - name: zmk-adaptive-key
      path: modules/zmk/adaptive-key
    - name: zmk-auto-layer
      path: modules/zmk/auto-layer
    - name: zmk-helpers
      path: modules/zmk/helpers
    - name: zmk-leader-key
      path: modules/zmk/leader-key
    - name: zmk-tri-state
      path: modules/zmk/tri-state

    # Temporarily overload Zephyr until
    # https://github.com/zmkfirmware/zephyr/pull/40 is merged.
    - name: zephyr
      revision: v3.5.0+zmk-fixes
      clone-depth: 1
      import:
        # Only enable most commonly used boards. For less common hardware one
        # may need to enable additional modules.
        name-allowlist:
          - cmsis
          - hal_nordic
          - hal_rpi_pico
          - hal_stm32
          - lvgl
          - tinycrypt

  self:
    path: config
```
